## Kconfig
```kconfig
choice
	prompt "Architecture select"
	default ARCH_ARM
	config ARCH_ARM
		bool "ARM architecture"
	config ARCH_RISCV
		bool "RISCV architecture"
endchoice
choice
	prompt "Platform"
	default PLATFORM_Q628
	config PLATFORM_Q628
		bool "Q628"
	config PLATFORM_8388
		bool "8388"
	config PLATFORM_I137
		bool "I137"
	config PLATFORM_3502
		bool "3502"
	config PLATFORM_I143
		bool "I143"
	config PLATFORM_Q645
		bool "Q645"
	config PLATFORM_SP7350
		bool "SP7350"
endchoice

choice
prompt "DRAM type"
default LPDDR4
depends on PLATFORM_Q645 || PLATFORM_SP7350
config  LPDDR4
	bool "LPDDR4"
config DDR4
	bool "DDR4"
config LPDDR3
	bool "LPDDR3"
config DDR3
	bool "DDR3"
endchoice

choice
prompt "DRAM part number"
depends on PLATFORM_Q645 || PLATFORM_SP7350
config  NT6AN1024F32AV
	depends on LPDDR4
	bool "NT6AN1024F32AV"
	help
	  Nanya NT6AN1024F32AV, 1Gbx32, 2 rank
config MT53D1024M32D4
	depends on LPDDR4
	bool "MT53D1024M32D4 D9WHT"
	help
	  Micron MT53D1024M32D4, 1Gbx32, 2 rank, FBGA code = D9WHT
config MT53E1G32D2_A
	depends on LPDDR4
	bool "MT53E1G32D2_A D9ZQX"
	help
	  Micron MT53E1G32D2_A, 1Gbx32, 1 rank, FBGA code = D9ZQX
config MT53E1G32D2_B
	depends on LPDDR4
	bool "MT53E1G32D2_B D8CJG"
	help
	  Micron MT53E1G32D2_B, 1Gbx32, 2 rank, FBGA code = D8CJG
config MT40A512M16TB
	depends on DDR4
	bool "MT40A512M16TB D8BPK"
	help
	  Micron MT40A512M16TB, 512Mx16, 1 rank, FBGA code = D8BPK
config MT41K512M16VRP
	depends on DDR3
	bool "MT41K512M16VRP D9ZWN"
	help
	  Micron MT41K512M16VRP, 512Mx16, 1 rank, FBGA code = D9ZWN
config K4AAG165WA
	depends on DDR4
	bool "K4AAG165WA"
	help
	  SAMSUNG K4AAG165WA, 1Gx16, 1 rank
config K4B8G1646D
	depends on DDR3
	bool "K4B8G1646D"
	help
	  SAMSUNG K4B8G1646D, 512Mx16, 2 rank
endchoice

config PLATFORM_IC_REV
	int "IC revision number"
	range 1 2
	default 1
	help
	  IC revision number. First IC is 1.
	  A new IC revision may have a different SRAM layout.

config XIP_SPIBAREMETAL
	bool "iBoot is XIP on SPI NOR (SPI Baremetal Boot)"
	help
	  Select if iBoot is XIP on SPI_NOR.

config BOOT_ON_CSIM
	bool "Build for CSIM"

config BOOT_ON_ZEBU
	bool "Boot on Zebu"
	depends on BOOT_ON_CSIM

config USE_ZMEM
	bool "Use ZMEM to skip image loading"
	depends on BOOT_ON_ZEBU

config HAVE_UART_BOOTSTRAP
	bool "UART Bootstrap"
	default y

config HAVE_USB_DISK
	bool "USB2 disk driver"
	select HAVE_FS_FAT
	help
	  Sunplus EHCI dirver, need to disable HAVE_SNPS_USB3_DISK

config HAVE_USB_HUB
	bool "USB2 hub supported"
	depends on HAVE_USB_DISK

config HAVE_SNPS_USB3_DISK
	bool "Synopsys USB 3.1 disk driver"
	select HAVE_FS_FAT
	help
	  Sunplus synopsys XHCI dirver, need to disable HAVE_USB_DISK

config HAVE_USB3_HUB
	bool "USB hub supported by xhci"
	depends on HAVE_SNPS_USB3_DISK

config HAVE_OTP
	bool "OTP driver"

config HAVE_MMC
	bool "MMC common"
	help
	  Common MMC code for SD Card or eMMC.

config HAVE_I2C
	bool "I2C driver"
	depends on PLATFORM_SP7350
	help
	  I2C driver.

config HAVE_ADC
	bool "ADC driver"
	depends on PLATFORM_SP7350
	help
	  ADC driver.

config HAVE_SDCARD
	bool "SD Card driver"
	select HAVE_MMC
	select HAVE_FS_FAT

config HAVE_EMMC
	bool "eMMC driver"
	select HAVE_MMC

config HAVE_NAND_COMMON
	bool "NAND common"
	help
	  Common NAND code, like BCH support.

config HAVE_PARA_NAND
	bool "Parallel NAND"
	select HAVE_NAND_COMMON

config HAVE_SPI_NAND
	bool "SPI NAND"
	select HAVE_NAND_COMMON

config HAVE_FS_FAT
	bool "FAT32 filesystem"
	depends on HAVE_USB_DISK || HAVE_SNPS_USB3_DISK || HAVE_SDCARD

config HAVE_FS_FAT16
	bool "FAT16 filesystem"
	depends on HAVE_USB_DISK || HAVE_SNPS_USB3_DISK || HAVE_SDCARD

config HAVE_SPI_NOR
	bool "SPI NOR boot"
	default y

config HAVE_MON_SHELL
	bool "MON Shell"
	default y

config DEBUG_WITH_2ND_UART
	bool "Use 2nd UART as debug port"
	depends on HAVE_MON_SHELL

config STANDALONE_DRAMINIT
	bool "Use standalone draminit bin (depricated)"
	help
	  If yes, load and run draminit image at run-time.
	  If no, link draminit obj into xboot.

config PREBUILT_DRAMINIT_OBJ
	string "Provide pebuilt draminit obj path"
	depends on !STANDALONE_DRAMINIT
	default ""
	help
	  If empty, use recent ../draminit/plf_dram.o.

config HAVE_ARCH_FASTMEM
	bool "Use memset/memcpy fast assembly code"
	default y

menu "Power saving"
	config PARTIAL_CLKEN
		bool "Enable partial clocks to save power (heuristics)"
		depends on PLATFORM_Q628

	config DISABLE_CORE2_3
		bool "Disable A's core 2, 3"
		depends on PLATFORM_Q628
		help
		  Don't power on A's core 2, 3.
endmenu

config USE_ROM_SHARE
	bool "Use rom share"
	depends on PLATFORM_Q645 || PLATFORM_SP7350

config LOAD_BL31
	bool "Load and run BL31 (Secure Monitor)"
	default y
	depends on PLATFORM_Q645 || PLATFORM_SP7350

menu "Experiments"
	config A64_EL1
		bool "Drop from EL3 to EL1 in xBoot"
		depends on PLATFORM_Q645 || PLATFORM_SP7350
		help
		  By default, xboot is at EL3 AArch64.
		  Select this option to drop xBoot to NS-EL1(default)
		  or S-EL1 (please modify SCR_VALUE).

	config LOAD_LINUX
		bool "Load and run Linux"
	config LOAD_DTB
		bool "Load DTB (if Linux has no builtin DTB)"
		depends on LOAD_LINUX && !ARCH_NDS

endmenu

config SECURE_BOOT_SIGN
	bool "Sign image to enable Secure Boot"
	select HAVE_OTP
	help
	  Sign xboot image and append generated signature to it.
	  If IC OTP secure boot bit is enabled, ROM code only boots
	  signed xboot image.

config I143_C_P
	bool "I143_C_P"
	default y
	depends on ARCH_RISCV && XIP_SPIBAREMETAL=n
	help
	  I143_C_P(U54+CA7),CA7 code place in xboot.bin from 26K  to 27k
```
